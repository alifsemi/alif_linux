## Documentation/devicetree/bindings/arm/alif/devkit.yaml
```yaml
# SPDX-License-Identifier: GPL-2.0
%YAML 1.2
---
$id: http://devicetree.org/schemas/arm/alif/devkit.yaml#
$schema: http://devicetree.org/meta-schemas/core.yaml#

title: Alif Semiconductor Ensemble Devkits Device Tree Bindings

maintainers:
  - Hemanth Kumar <hemanth@alifsemi.com>

properties:
  compatible:
    oneOf:
      - enum:
          - alif,ensemble
...
```

## Documentation/devicetree/bindings/crypto/alif,alif-crccode.txt
```
* Alif Ensemble CRC

Required properties:
- compatible: Should be "alif,alif-crccode".
- reg: The address and length of the peripheral registers space
- clocks: The input clock of the CRC instance
- clock-names: should be "ahb_clk".

Example:
crc: crc@48107000 {
	compatible = "alif,alif-crccode";
	reg = <0x48107000 0x1000>;
	clocks = <&syst_hclk>;
	clock-names = "ahb_clk";
};
```

## Documentation/devicetree/bindings/display/alif,ensemble-dsi.txt
```
Display Serial Interface in Alif Ensemble SoC
=============================================

DSI Controller:
Required properties:
- #address-cells: Should be <1>.
- #size-cells: Should be <0>.
- compatible: Should be "alif,ensemble-dsi"
- reg: Physical base address and length of the registers of controller
- interrupts: The interrupt signal from the DSI block.
- clocks: Phandles to device clocks.
          Must be <&dpi_pixclk>, <&pllref>, and <&cfgclk>
- clock-names: Must be "pclk", "ref", "cfgclk".
- ports: A node containing DSI input & output port nodes with endpoint
  definitions as documented in [3] & [4].
  - port@0: DSI input port node, connected to the ltdc rgb output port.
  - port@1: DSI output port node, connected to a panel or a bridge input port.
- panel or bridge node: A node containing the panel or bridge description as
  documented in [6].
  - port: panel or bridge port node, connected to the DSI output port (port@1).

Note: You can find more documentation in the following references
[1] Documentation/devicetree/bindings/clock/clock-bindings.txt
[2] Documentation/devicetree/bindings/reset/reset.txt
[3] Documentation/devicetree/bindings/media/video-interfaces.txt
[4] Documentation/devicetree/bindings/graph.txt
[5] Documentation/devicetree/bindings/display/bridge/dw_mipi_dsi.txt
[6] Documentation/devicetree/bindings/display/mipi-dsi-bus.txt

Example:
dsi: dsi@0x49032000 {
	#address-cells = <1>;
	#size-cells = <0>;
	compatible = "alif,ensemble-dsi";
	reg = <0x49032000 0x1000>;
	interrupts = <0 332 IRQ_TYPE_LEVEL_HIGH>;
	clocks = <&dpi_pixclk>,
		 <&pllref>,
		 <&cfgclk>;
	clock-names = "pclk", "ref", "cfgclk";
	status = "okay";

	ports {
		#address-cells = <1>;
		#size-cells = <0>;
		port@0 {
			reg = <0>;
			dsi_in: endpoint {
				remote-endpoint =
					<&cdc_out1_rgb>;
			};
		};
		port@1 {
			reg = <1>;
			dsi_out: endpoint {
				remote-endpoint =
					<&panel_dsi>;
			};
		};
	};
	paneldsi: panel-dsi@0 {
		reg = <0>;
		compatible = "focuslcd,fw405";
		/* reset-gpios = <&gpio4 6 GPIO_ACTIVE_LOW>; */
		backlight = <&panel_backlight>;
		power-supply = <&reg_3p3v>;
		status = "okay";

		port {
			panel_dsi: endpoint {
				remote-endpoint = <&dsi_out>;
			};
		};
	};
};
```

## Documentation/devicetree/bindings/display/tes/tes,cdc-2.1.txt
```
TES Customizable Display Controller (CDC)
=========================================

Required properties:
- compatible : Must be "tes,cdc-2.1"
- reg : should contain 1 register range (address and length).
- interrupts-parent: Phandle for interrupt controller.
- interrupts: List of Interrupt numbers.
- clocks: Input clock specifier. Refer to common clock bindings.
- max-clock-frequency: Maximum operating clock frequency.
                       Must be 400000000.
- ports: A ports node with endpoint definitions as defined in
  Documentation/devicetree/bindings/media/video-interfaces.txt.

Example:
cdc200: cdc200@49031000 {
        compatible = "tes,cdc-2.1";
        reg = <0x49031000 0x1000>;
        interrupt-parent = <&gic>;
        status = CDC200_STATUS;
        interrupts =    <0 322 IRQ_TYPE_LEVEL_HIGH>,
                        <0 323 IRQ_TYPE_LEVEL_HIGH>,
                        <0 324 IRQ_TYPE_LEVEL_HIGH>,
                        <0 325 IRQ_TYPE_LEVEL_HIGH>,
                        <0 326 IRQ_TYPE_LEVEL_HIGH>,
                        <0 327 IRQ_TYPE_LEVEL_HIGH>,
                        <0 328 IRQ_TYPE_LEVEL_HIGH>,
                        <0 329 IRQ_TYPE_LEVEL_HIGH>,
                        <0 330 IRQ_TYPE_LEVEL_HIGH>,
                        <0 331 IRQ_TYPE_LEVEL_HIGH>;
        clocks = <&pixclk>;
        max-clock-frequency = <400000000>;

        ports {
                #address-cells = <1>;
                #size-cells = <0>;
                port@0 {
                        reg = <0>;
                        cdc_out_rgb: endpoint {
                        /* remote-endpoint = <&lvdsenc_in>; */
                        };
                };
                port@1 {
                        reg = <1>;
                        cdc_out1_rgb: endpoint {
                                remote-endpoint = <&dsi_in>;
                        };
                };
        };
};
```

## Documentation/devicetree/bindings/display/tes/tes-drm.txt
```
TES DRM master device
=====================

Required properties:
- compatible: "tes,d2d-1.0"
- reg: Base address and size of the IP core instance.
- interrupts-parent: Phandle for interrupt controller.
- interrupts: List of Interrupt numbers.
- clocks: Input clock specifier. Refer to common clock bindings.
- max-clock-frequency: Maximum operating clock frequency.
                       Must be 400000000.
Example:
tes_d2d_0: gpu@49040000 {
	reg = <0x49040000 0x1000>;
	compatible = "tes,d2d-1.0";
	status = DAVE_2D_STATUS;
	interrupt-parent = <&gic>;
	interrupts = <0 321 IRQ_TYPE_LEVEL_HIGH>;
	clocks = <&syst_aclk>;
	max-clock-frequency = <400000000>;
};
```

## Documentation/devicetree/bindings/hwlock/alif,hwsem.txt
```
Alif Ensemble Hardware Semaphore(HWSEM) Binding
-----------------------------------------------

Required properties :
- compatible: should be "alif,hwsem".
- reg: the register address of hardware semaphore.
- reg-names: Names for the register areas. Must contain "hwsem_base".
- interrupts-parent: Phandle for interrupt controller.
- interrupts: List of Interrupt numbers.
- clocks: Must contain an entry for each entry in clock-names.
          Please refer to clock-bindings.txt.
- clock-names: Should be one of each entry matching the clocks phandles list.
               Must contain "apb_pclk".

Example of HWSEM provider:
hwsem0: hwsem0@4902E000 {
	compatible = "alif,hwsem";
	reg = <0x4902E000 0x4>;
	reg-names = "hwsem_base";
	interrupt-parent = <&gic>;
	interrupts = <0 30 4>;
	clocks = <&syst_pclk 0>;
	clock-names = "apb_pclk" ;
	status = HWSEM0_STATUS;
};
```

## Documentation/devicetree/bindings/i3c/snps,dw-i3c-master.txt
```
Bindings for Synopsys DesignWare I3C master block
=================================================

Required properties:
--------------------
- compatible: shall be "snps,dw-i3c-master-1.00a"
- clocks: shall reference the core_clk
- interrupts: the interrupt line connected to this I3C master
- reg: Offset and length of I3C master registers

Mandatory properties defined by the generic binding (see
Documentation/devicetree/bindings/i3c/i3c.txt for more details):

- #address-cells: shall be set to 3
- #size-cells: shall be set to 0

Optional properties defined by the generic binding (see
Documentation/devicetree/bindings/i3c/i3c.txt for more details):

- i2c-scl-hz
- i3c-scl-hz

I3C device connected on the bus follow the generic description (see
Documentation/devicetree/bindings/i3c/i3c.txt for more details).

Examples:

	i3c-master@2000 {
		compatible = "snps,dw-i3c-master-1.00a";
		#address-cells = <3>;
		#size-cells = <0>;
		reg = <0x02000 0x1000>;
		interrupts = <0>;
		clocks = <&i3cclk>;

		eeprom@57{
			compatible = "atmel,24c01";
			reg = <0x57 0x0 0x10>;
			pagesize = <0x8>;
		};
	};

	i3c0: i3c@49018000 {
		compatible = "snps,dw-i3c-master-1.00a";
		pinctrl-names = "default";
		pinctrl-0 = <&pinctrl_i3c0>;
		reg = <0x49018000 0x1000>;
		interrupts = <GIC_SPI 125 IRQ_TYPE_LEVEL_HIGH>;
		clocks = <&syst_pclk>;
		#address-cells = <3>;
		#size-cells = <0>;
		i2c-scl-hz = <100000>;
		status = "disabled";

		/* I3C device with an Image sensor */
		arx3a0@36 {
			compatible = "onnn,arx3a0";
			reg = <0x36 0x0 0x4000>;
			clocks = <&ext_clk>;
			clock-names = "extclk";
			reset-gpio =
			<&port4 5 (GPIO_ACTIVE_LOW | GPIO_OPEN_DRAIN)>;
			vaa-supply = <&reg_2p7v>;
			vdd-supply = <&reg_1p2v>;
			vdd_io-supply = <&reg_1p8v>;
			port@0 {
				arx3a0_csi2_ep: endpoint@0 {
					bus-type = <4>;
					clock-lanes = <0>;
					data-lanes = <1 2>;
					remote-endpoint = <&csi2_in>;
				};
			};
		};
	};
```

## Documentation/devicetree/bindings/iio/adc/alif,adc-dev.txt
```
Alif ADC12/ADC24 device driver

Required properties:
- compatible: Must be "alif,adc-dev"
- reg: Address and length of the device's register set.
- clock-names: List of input clocks.
  Required elements: "apb_pclk"
- clocks: Input clock specifier. Refer to common clock bindings.


Examples:
adc0: adc12_0@49020000 {
	compatible = "alif,adc-dev";
	reg = <0x49020000 0x100>;
	clocks = <&syst_pclk 0>;
	clock-names = "apb_pclk" ;
	status = ADC120_STATUS;
};
adc1: adc12_1@49021000 {
	compatible = "alif,adc-dev";
	reg = <0x49021000 0x100>;
	clocks = <&syst_pclk 0>;
	clock-names = "apb_pclk" ;
	status = ADC121_STATUS;
};
adc2: adc12_2@49022000 {
	compatible = "alif,adc-dev";
	reg = <0x49022000 0x100>;
	clocks = <&syst_pclk 0>;
	clock-names = "apb_pclk" ;
	status = ADC122_STATUS;
};
adc24: adc24@49027000 {
	compatible = "alif,adc-dev";
	reg = <0x49027000 0x100>;
	clocks = <&syst_pclk 0>;
	clock-names = "apb_pclk" ;
	status = ADC24_STATUS;
};
```

## Documentation/devicetree/bindings/iio/dac/alif,ensemble-dac.txt
```
Alif Ensemble DAC device driver

Required properties:
- compatible: Must be "alif,ensemble-dac"
- reg: Address and length of the device's register set.
- clock-names: List of input clocks.
  Required elements: "apb_pclk"
- clocks: Input clock specifier. Refer to common clock bindings.


Examples:
dac0: dac12_0@49028000 {
	compatible = "alif,ensemble-dac";
	reg = <0x49028000 0x10>;
	clocks = <&syst_pclk 0>;
	clock-names = "apb_pclk" ;
	status = DAC120_STATUS;
};
dac1: dac12_1@49029000 {
	compatible = "alif,ensemble-dac";
	reg = <0x49029000 0x10>;
	clocks = <&syst_pclk 0>;
	clock-names = "apb_pclk" ;
	status = DAC121_STATUS;
};
```

## Documentation/devicetree/bindings/iio/imu/bosch,bmi323.yaml
```yaml
# SPDX-License-Identifier: (GPL-2.0 OR BSD-2-Clause)

%YAML 1.2
---
$id: http://devicetree.org/schemas/iio/imu/bosch,bmi323.yaml#

$schema: http://devicetree.org/meta-schemas/core.yaml#
title: Bosch BMI323 6-Axis IMU

maintainers:

  - Jagath Jog J <jagathjog1996@gmail.com>



description:

  BMI323 is a 6-axis inertial measurement unit that supports acceleration and

  gyroscopic measurements with hardware fifo buffering. Sensor also provides

  events information such as motion, steps, orientation, single and double

  tap detection.

properties:

  compatible:

    const: bosch,bmi323

  reg:

    maxItems: 1

  interrupts:

    maxItems: 1

  interrupt-names:

    enum:

      - INT1

      - INT2

    description: |

      set to "INT1" if INT1 pin should be used as interrupt input, set

      to "INT2" if INT2 pin should be used instead

  drive-open-drain:

    description: |

      set if the specified interrupt pin should be configured as

      open drain. If not set, defaults to push-pull.

required:

  - compatible

  - reg

allOf:

  - $ref: /schemas/spi/spi-peripheral-props.yaml#

unevaluatedProperties: false

examples:

  - |

    // Example for I2C

    #include <dt-bindings/interrupt-controller/irq.h>

    i2c {

        #address-cells = <1>;

        #size-cells = <0>;


        bmi323@68 {

            compatible = "bosch,bmi323";

            reg = <0x68>;

            interrupt-parent = <&gpio1>;

            interrupts = <29 IRQ_TYPE_EDGE_RISING>;

            interrupt-names = "INT1";

        };

    };

  - |

    // Example for SPI

    #include <dt-bindings/interrupt-controller/irq.h>

    spi {

        #address-cells = <1>;

        #size-cells = <0>;


        bmi323@0 {

            compatible = "bosch,bmi323";

            reg = <0>;

            spi-max-frequency = <10000000>;

            interrupt-parent = <&gpio2>;

            interrupts = <12 IRQ_TYPE_EDGE_FALLING>;

            interrupt-names = "INT2";

        };

    };
```

## Documentation/devicetree/bindings/media/alif,ensemble-cpi.txt
```
Alif Ensemble Camera Controller CPI device driver
=================================================

Required properties:
- #address-cells: Should be <1>.
- #size-cells: Should be <0>.
- pinctrl-names: Should contain only one value - "default"
- pinctrl-0: Should specify pin control groups used for this controller.
- compatible: Must be "alif,ensemble-cpi"
- reg: the register base and size for the device registers
- interrupts-parent: Phandle for interrupt controller.
- interrupts: the interrupt for the device.
- clocks: Phandles to device clocks.
          Must be <&camera_pixclk>.
- clock-names: Must be "camera_pixclk".
- port: child port node, in accordance with the video interface
        bindings defined in
        Documentation/devicetree/bindings/media/video-interfaces.txt.
        The port node must contain at least one endpoint.

Example:
--------
cpi:  camera_ctrl@49030000 {
	#address-cells = <1>;
	#size-cells = <0>;
	pinctrl-names = "default";
	pinctrl-0 = <&pinctrl_camera>;
	compatible = "alif,ensemble-cpi";
	reg = <0x49030000 0x1000>;
	interrupt-parent = <&gic>;
	interrupts = <GIC_SPI 334 IRQ_TYPE_LEVEL_HIGH>;
	clocks = <&camera_pixclk>;
	clocks-names = "camera_pixclk";
	status = "ok";
	port {
		#address-cells = <1>;
		#size-cells = <0>;
		cpi_csi2_in: endpoint@0 {
			reg = <0>;
			remote-endpoint = <&csi2_out>;
		};
	};
};
```

## Documentation/devicetree/bindings/media/snps,dw-csi.txt
```
Synopsys MIPI CSI-2
-------------------

Required properties:
- compatible: Must be "snps,dw-csi"
- #address-cells: Should be <1>.
- #size-cells: Should be <0>.
- reg: the register base and size for the device registers
- interrupts-parent: Phandle for interrupt controller.
- interrupts: the interrupt for the device
- phys: phandle to the external D-PHY.

The device node shall contain two 'port' child nodes according to the
bindings defined in Documentation/devicetree/bindings/media/
video-interfaces.txt.

Example:
--------

csi2: csi2@49033000 {
	compatible = "snps,dw-csi";
	#address-cells = <1>;
	#size-cells = <0>;
	reg = <0x49033000 0x1000>;
	phys = <&mipi_dphy_rx 1>;
	/* resets = <&dw_rst 1>; */
	interrupt-parent = <&gic>;
	interrupts = <GIC_SPI 333 IRQ_TYPE_LEVEL_HIGH>;

	port@1 {
		reg = <1>;
		csi2_in: endpoint {
			bus-type = <4>;
			clock-lanes = <0>;
			data-lanes = <2 1>;
			remote-endpoint = <&arx3a0_csi2_ep>;
		};
	};
	port@2 {
		reg = <2>;
		csi2_out: endpoint {
			remote-endpoint = <&cpi_csi2_in>;
		};
	};
};
```
