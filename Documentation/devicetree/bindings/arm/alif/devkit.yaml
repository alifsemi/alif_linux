## Documentation/devicetree/bindings/phy/snps,dw-dphy-rx.txt
```
Synopsys DSI PHY for Alif Ensemble SoC

The Synopsys MIPI-DSI PHY IP block is e.g. found on Alif Ensemble platforms.

Required properties:
- compatible: Must be:
  - "snps,dw-dphy-rx"
- clocks: Must contain an entry for each entry in clock-names.
- reg: the register range of the PHY controller
- bus-width: Number of data lines. Should be <12>.
- snps,dphy-frequency: the phy core clk frequency, should be: 400000000
- snps,phy_type: Should be <1>
- #phy-cells: number of cells in PHY, as defined in
  Documentation/devicetree/bindings/phy/phy-bindings.txt
  this must be <1>

Example:
mipi_dphy_rx:  dphy@49033040 {
	compatible = "snps,dw-dphy-rx";
	reg = <0x49033040 0x40>;
	#phy-cells = <1>;
	bus-width = <12>;
	clocks = <&syst_pclk>;
	snps,dphy-frequency = <400000000>;
	snps,phy_type = <1>;
};
```

## Documentation/devicetree/bindings/pinctrl/alif,ensemble-pinctrl.txt
```
Alif Ensemble pinctrl driver
============================

Required properties:
- compatible: "alif,pinctrl-devkit"
- reg: Base address of the PinMux register block and the size of the block.
       Base address of the Configuration master 0 (CFGMST0) block and
       the size of the block.

Example:
--------
pinmux: pinctrl@1A603000 {
	compatible = "alif,pinctrl-devkit";
	reg = <0x1A603000 0x00001000>,
	      <0x4902F000 0x00001000>;
};
```

## Documentation/devicetree/bindings/rtc/alif,devkit-rtc.txt
```
* Alif Ensemble Real Time Clock

RTC controller for the Alif Ensemble Time Clock

Required properties:
- compatible: Should be "alif,devkit-rtc"
- reg: physical base address of the controller and length of memory mapped
  region.
- interrupts: IRQ line for the RTC.
- clocks: Must contain an entry for each entry in clock-names.
          Please refer to clock-bindings.txt.
- clock-names: Should be one of each entry matching the clocks phandles list:
                  - "timer" (timer clock) Required.
                  - "pclk" (peripheral clock) Required.
Example:
rtc: rtc@42000000 {
	compatible = "alif,devkit-rtc";
	reg = <0x42000000 0x100>;
	interrupts = <GIC_SPI 339  IRQ_TYPE_LEVEL_HIGH>;
	clocks = <&rtc_clk>, <&syst_pclk>;
	clock-names = "timer", "pclk";
};
```

## Documentation/devicetree/bindings/sound/alif,alif-pcm-card.txt
```
Alif Ensemble SoC Sound Card

Required properties:
- compatible: "alif,alif-pcm-card"
- clocks: Input clock specifier. Should be <&syst_pclk 0>.

Example:
pcmcard: pcmcard@4902D800 {
	compatible = "alif,alif-pcm-card";
	clocks = <&syst_pclk 0>;
};
```

## Documentation/devicetree/bindings/sound/alif,alif-pcm.txt
```
Alif Ensemble PCM audio CODEC

Required properties:
 - compatible: "alif,alif-pcm"
 - pinctrl-names: Should contain only one value - "default"
 - pinctrl-0: Should specify pin control groups used for this controller.
 - reg: Base address and size of the IP core instance.
 - interrupts-parent: Phandle for interrupt controller.
 - interrupts: List of Interrupt numbers.
 - clock-names: List of input clocks.
   Required elements: "pclk"
 - clocks: Input clock specifier. Refer to common clock bindings.

Example:
pcm: pcm@4902D000 {
	compatible = "alif,alif-pcm";
	pinctrl-names = "default";
	pinctrl-0 = <&pinctrl_pcm0>;
	reg = <0x4902D000 0x800>;
	clocks = <&syst_pclk 0>;
	clock-names = "pclk";
	interrupt-parent = <&gic>;
	interrupts = <0 134 IRQ_TYPE_LEVEL_HIGH>;
	status = PCM_STATUS;
};
```

## Documentation/devicetree/bindings/sound/invensense,t5848.txt
```
* Invensense T5848 MEMS Silicon Microphones

Required properties:
- compatible: Should be "invensense,t5848"
- #sound-dai-cells: should be 0.

Example of the Alif Ensemble 7 SoC:

t5848: acodec {
	#sound-dai-cells = <0>;
	compatible = "invensense,t5848";
};

Example of a "simple-audio-card":
sound-memsmic {
	compatible = "simple-audio-card";
	simple-audio-card,name = "mems-mic";
	simple-audio-card,format = "i2s";
	simple-audio-card,frame-master = <&cpudai_1>;
	simple-audio-card,bitclock-master = <&cpudai_1>;

	cpudai_1: simple-audio-card,cpu {
		sound-dai = <&i2s3>;
	};

	mcodec: simple-audio-card,codec {
		sound-dai = <&t5848>;
	};
};
```

## Documentation/devicetree/bindings/sound/knowles,sph0645.txt
```
* Knowles SP Series SiSonic MEMS Silicon Microphones

Required properties:
- compatible: "knowles,sph0645"
- #sound-dai-cells: should be 0.

Example of the Alif Ensemble 7 SoC:

sph0645: acodec {
	#sound-dai-cells = <0>;
	compatible = "knowles,sph0645";
};

Example of a "simple-audio-card":
sound-memsmic {
	compatible = "simple-audio-card";
	simple-audio-card,name = "mems-mic";
	simple-audio-card,format = "i2s";
	simple-audio-card,frame-master = <&cpudai_1>;
	simple-audio-card,bitclock-master = <&cpudai_1>;

	cpudai_1: simple-audio-card,cpu {
		sound-dai = <&i2s2>;
	};

	mcodec: simple-audio-card,codec {
		sound-dai = <&sph0645>;
	};
};
```

## Documentation/devicetree/bindings/timer/alif,alif-utimer.txt
```
Alif Ensemble Utimer
--------------------

Required properties:
- compatible should contain:
	* "alif,alif-utimer"
- reg : the register address space of the utimer.
- interrupts-parent: Phandle for interrupt controller.
- interrupts: List of Interrupt numbers.
- clocks: Must contain an entry for each entry in clock-names.                   Please refer to clock-bindings.txt.
- clock-names: Should be one of each entry matching the clocks phandles list.
               Must contain "axi_clk".

Examples:
utimer: utimer@48000000 {
	compatible = "alif,alif-utimer";
	clocks = <&syst_aclk>;
	clock-names = "axi_clk" ;
	reg = <0x48000000 0x100000>;
	interrupt-parent = <&gic>;
	interrupts = <GIC_SPI 366 IRQ_TYPE_EDGE_RISING>,
		...
};
```

## arch/arm/configs/bolt-rev-a0_defconfig
```kconfig
CONFIG_LOG_BUF_SHIFT=13
CONFIG_RD_BZIP2=n
CONFIG_RD_LZMA=n
CONFIG_RD_XZ=n
CONFIG_RD_LZO=n
CONFIG_RD_LZ4=n
#CONFIG_ARCH_TINY_VEXPRESS=y
CONFIG_ARCH_BOLT=y
CONFIG_SOC_BOLT=y
CONFIG_ARM_SINGLE_ARMV7A=y
#CONFIG_DRAM_BASE=0x02100000
CONFIG_PHYS_OFFSET=0x02000000
CONFIG_FLASH_MEM_BASE=0x80000000
CONFIG_FLASH_SIZE=0x800000
CONFIG_XIP_KERNEL=y
CONFIG_XIP_PHYS_ADDR=0x08000000
CONFIG_HAVE_ARM_ARCH_TIMER=y
# CONFIG_CMA=y
CONFIG_ZBOOT_ROM_TEXT=0x0
CONFIG_ZBOOT_ROM_BSS=0x0
CONFIG_CMDLINE="console=ttyS1"
# CONFIG_CPU_IDLE=y
# CONFIG_CPU_IDLE_MULTIPLE_DRIVERS=y
CONFIG_VFP=y
CONFIG_NEON=y
CONFIG_KERNEL_MODE_NEON=y
# CONFIG_CORE_DUMP_DEFAULT_ELF_HEADERS is not set
CONFIG_MQ_IOSCHED_DEADLINE=n
CONFIG_MQ_IOSCHED_KYBER=n
CONFIG_NET=n
#CONFIG_PACKET=y
#CONFIG_UNIX=y
#CONFIG_INET=y
#CONFIG_IP_PNP=y
#CONFIG_IP_PNP_DHCP=y
#CONFIG_IP_PNP_BOOTP=y
# CONFIG_INET_LRO is not set
# CONFIG_IPV6 is not set
# CONFIG_WIRELESS is not set
# CONFIG_NET_9P=y
# CONFIG_NET_9P_VIRTIO=y
# CONFIG_UEVENT_HELPER_PATH="/sbin/hotplug"
CONFIG_DEVTMPFS=y
CONFIG_MTD=y
CONFIG_MTD_CMDLINE_PARTS=y
CONFIG_MTD_BLOCK=y
CONFIG_MTD_RAM=y
CONFIG_MTD_ROM=y
# CONFIG_MTD_CFI_INTELEXT=y
# CONFIG_MTD_CFI_AMDSTD=y
CONFIG_MTD_PHYSMAP=y
CONFIG_MTD_PHYSMAP_COMPAT=y
CONFIG_MTD_PHYSMAP_START=0x62000000
CONFIG_MTD_PHYSMAP_LEN=0x100000
CONFIG_MTD_PHYSMAP_BANKWIDTH=4
CONFIG_MTD_PHYSMAP_OF=y
CONFIG_MTD_PLATRAM=y
# CONFIG_MTD_UBI=y
# CONFIG_PROC_DEVICETREE=y
# CONFIG_VIRTIO_BLK=y
# CONFIG_SCSI_PROC_FS is not set
# CONFIG_BLK_DEV_SD=y
# CONFIG_SCSI_VIRTIO=y
# CONFIG_ATA=y
# CONFIG_SATA_PMP is not set
CONFIG_NETDEVICES=y
CONFIG_VIRTIO_NET=y
CONFIG_SMC91X=y
CONFIG_SMSC911X=y
CONFIG_INPUT_KEYBOARD=n
CONFIG_INPUT_MOUSE=n
# CONFIG_WLAN is not set
# CONFIG_INPUT_EVDEV=y
# CONFIG_SERIO_SERPORT is not set
# CONFIG_SERIO_AMBAKMI=y
# CONFIG_LEGACY_PTY_COUNT=16
#CONFIG_SERIAL_AMBA_PL011=y
#CONFIG_SERIAL_AMBA_PL011_CONSOLE=y
# SERIAL
CONFIG_VT=n
CONFIG_UNIX98_PTYS=n
CONFIG_LEGACY_PTYS=n
CONFIG_SERIAL_EARLYCON=y
CONFIG_SERIAL_8250=y
CONFIG_SERIAL_8250_DEPRECATED_OPTIONS=y
CONFIG_SERIAL_8250_CONSOLE=y
CONFIG_SERIAL_8250_NR_UARTS=8
CONFIG_SERIAL_8250_RUNTIME_UARTS=8
CONFIG_SERIAL_8250_DWLIB=y
CONFIG_SERIAL_8250_DW=y
# I2C
CONFIG_I2C_DESIGNWARE_CORE=y
CONFIG_I2C_DESIGNWARE_PLATFORM=y
CONFIG_I3C=y
CONFIG_DW_I3C_MASTER=y
#GPIO
CONFIG_GPIO_GENERIC=y
CONFIG_GPIO_DWAPB=y
# CONFIG_LEDS_TRIGGER_CPU=y
CONFIG_RTC_CLASS=y
CONFIG_RTC_DRV_PL031=y
CONFIG_TMPFS=y
CONFIG_CRAMFS=y
CONFIG_CRAMFS_MTD=y
CONFIG_THUMB2_KERNEL=y
CONFIG_MAILBOX=y
CONFIG_ARM_MHUv2=y
CONFIG_RPMSG=y
CONFIG_RPMSG_CHAR=y
CONFIG_RPMSG_ARM=y
CONFIG_EXTSYS_CTRL=y
CONFIG_CC_OPTIMIZE_FOR_SIZE=y
CONFIG_CC_DISABLE_WARN_MAYBE_UNINITIALIZED=y
# CONFIG_SWAP is not set
CONFIG_I2C=y
CONFIG_I2C_BOARDINFO=y
CONFIG_I2C_COMPAT=y
CONFIG_I2C_CHARDEV=y
CONFIG_I2C_MUX=y
CONFIG_I2C_HELPER_AUTO=y
CONFIG_I2C_SLAVE=y
CONFIG_SPI=y
CONFIG_SPI_MASTER=y
CONFIG_TLS=y
CONFIG_PPP=y
CONFIG_USB_SUPPORT=n
CONFIG_STAGING=n
CONFIG_FAT_FS=y
CONFIG_EXFAT_FS=y
CONFIG_VFAT_FS=y
CONFIG_FAT_DEFAULT_UTF8=y
CONFIG_NLS_CODEPAGE_437=y
CONFIG_NLS_ISO8859_1=y
CONFIG_NLS_UTF8=y
```

## arch/arm/mach-bolt/Kconfig
```kconfig
# SPDX-License-Identifier: GPL-2.0-only
menuconfig ARCH_BOLT
	bool "Alif Bolt SoCs"
	#depends on ARCH_MULTI_V4T || ARCH_MULTI_V5 || ARCH_MULTI_V7 || ARM_SINGLE_ARMV7M
	depends on ARM_SINGLE_ARMV7A
	select GPIOLIB
	select PINCTRL
	select PINCTRL_BOLT
	#select SOC_BUS
	select ARCH_SUPPORTS_BIG_ENDIAN
	select ARM_AMBA
	select ARM_GIC
	select ARM_GLOBAL_TIMER
	select ARM_TIMER_SP804
	#select COMMON_CLK_VERSATILE
	select GPIOLIB
	select HAVE_ARM_SCU if SMP
	select HAVE_ARM_TWD if SMP
	select HAVE_PATA_PLATFORM
	select ICST
	select NO_IOPORT_MAP
	#select PLAT_VERSATILE
	select POWER_RESET
	#select POWER_RESET_VEXPRESS
	select POWER_SUPPLY
	select REGULATOR if MMC_ARMMMCI
	select REGULATOR_FIXED_VOLTAGE if REGULATOR
	#select VEXPRESS_CONFIG
	#select VEXPRESS_SYSCFG
	#select MFD_VEXPRESS_SYSREG
	help
	  This option enables support for tiny linux based systems using Cortex
	  processor based ARM core and logic (FPGA) tiles on the Versatile
	  Express motherboard.

if ARCH_BOLT
config SOC_BOLT
	bool "Alif Bolt C8"
	#select COMMON_CLK_AT91
	#select PINCTRL_AT91
	help
	  Select this if you are using an SoC from Alif Bolt

endif
```

## arch/arm/mach-ensemble/Kconfig
```kconfig
# SPDX-License-Identifier: GPL-2.0-only
menuconfig ARCH_ENSEMBLE
	bool "Alif Devkit-Ex SoCs"
	select ARCH_SPARSEMEM_ENABLE
	select NEED_MACH_MEMORY_H
	select HIGHMEM
	select PINCTRL
	select PINCTRL_DEVKIT
	select GPIOLIB
	select ARM_AMBA
	select ARM_GIC
	select ARM_GLOBAL_TIMER
	select HAVE_PATA_PLATFORM
	select ICST
	select NO_IOPORT_MAP
	select POWER_RESET
	select POWER_SUPPLY
	help
	  This option enables support for tiny linux based systems using Cortex
	  processor based ARM core and logic (FPGA) tiles on the Versatile
	  Express motherboard.

if ARCH_ENSEMBLE
config SOC_ENSEMBLE
	bool "Alif Devkit-Ex"
	help
	  Select this if you are using an SoC from Alif Bolt

endif
```

## drivers/gpu/drm/alif/Kconfig
```kconfig
# SPDX-License-Identifier: GPL-2.0
config DRM_ALIF_DSI
	bool "Alif Ensemble specific extensions for Synopsys MIPI DSI"
	depends on DRM_ALIF
	select DRM_DW_MIPI_DSI
	help
	  Choose this option for MIPI DSI support on Alif Ensemble SoC.
```

## drivers/gpu/drm/d2d/Kconfig
```kconfig
# SPDX-License-Identifier: GPL-2.0
# Copyright (C) 2023 Alif Semiconductor - All Rights Reserved.
# Use, distribution and modification of this code is permitted under the
# terms stated in the Alif Semiconductor Software License Agreement
#
# You should have received a copy of the Alif Semiconductor Software
# License Agreement with this file. If not, please write to:
# contact@alifsemi.com, or visit: https://alifsemi.com/license
config DRM_D2D
	tristate "DRM Support for TES D/AVE-2D for Alif Ensemble SoC."
	depends on DRM && OF
	depends on ARM
	depends on ARCH_ENSEMBLE
	select DRM_GEM_CMA_HELPER
	default y if ARCH_ENSEMBLE
	help
	  Choose this option if you have an Alif Ensemble SoC.
```
