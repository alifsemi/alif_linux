## drivers/gpu/drm/tes/Kconfig
```kconfig
# SPDX-License-Identifier: GPL-2.0
config DRM_TES_CDC
	tristate "DRM Support for TES CDC200"
	depends on DRM && OF
	depends on ARM
	depends on ARCH_ENSEMBLE
	select DRM_KMS_HELPER
	select DRM_KMS_CMA_HELPER
	select DRM_GEM_CMA_HELPER
	select VIDEOMODE_HELPERS
	help
	  Choose this option if you have an Alif Ensemble SoC.
```
